## br-external/Config.in
```kconfig
menu "PCI Dev Packages"
source "$BR2_EXTERNAL_PCI_DEV_PATH/package/crc_xcel_mod/Config.in"
source "$BR2_EXTERNAL_PCI_DEV_PATH/package/crc_xcel_lib/Config.in"
source "$BR2_EXTERNAL_PCI_DEV_PATH/package/lua_mod/Config.in"
endmenu
```

## br-external/configs/njd_qemu_x86_64_defconfig
```kconfig
BR2_x86_64=y
BR2_PACKAGE_HOST_LINUX_HEADERS_CUSTOM_6_18=y
BR2_TOOLCHAIN_BUILDROOT_CXX=y
BR2_CCACHE=y
BR2_GLOBAL_PATCH_DIR="board/qemu/patches $(BR2_EXTERNAL_PCI_DEV_PATH)/patches"
BR2_DOWNLOAD_FORCE_CHECK_HASHES=y
BR2_TARGET_GENERIC_HOSTNAME="njd-pci-dev"
BR2_INIT_SYSTEMD=y
BR2_SYSTEM_DHCP="eth0"
BR2_SYSTEM_DEFAULT_PATH="/bin:/sbin:/usr/bin:/usr/sbin"
BR2_ENABLE_LOCALE_WHITELIST="C en_GB"
BR2_ROOTFS_POST_BUILD_SCRIPT="board/qemu/x86_64/post-build.sh"
BR2_ROOTFS_POST_IMAGE_SCRIPT="board/qemu/post-image.sh"
BR2_ROOTFS_POST_SCRIPT_ARGS="$(BR2_DEFCONFIG)"
BR2_LINUX_KERNEL=y
BR2_LINUX_KERNEL_CUSTOM_TARBALL=y
BR2_LINUX_KERNEL_CUSTOM_TARBALL_LOCATION="https://cdn.kernel.org/pub/linux/kernel/v6.x/linux-6.19.6.tar.xz"
BR2_LINUX_KERNEL_USE_CUSTOM_CONFIG=y
BR2_LINUX_KERNEL_CUSTOM_CONFIG_FILE="$(BR2_EXTERNAL_PCI_DEV_PATH)/configs/kernel.config"
BR2_LINUX_KERNEL_NEEDS_HOST_LIBELF=y
BR2_PACKAGE_PCIUTILS=y
BR2_TARGET_ROOTFS_EXT2=y
# BR2_TARGET_ROOTFS_TAR is not set
BR2_PACKAGE_HOST_QEMU=y
BR2_PACKAGE_HOST_QEMU_SYSTEM_MODE=y
BR2_PACKAGE_CRC_XCEL_MOD=y
BR2_PACKAGE_CRC_XCEL_LIB=y
BR2_PACKAGE_LUA_MOD=y
```

## br-external/package/crc-test-mod/Config.in
```kconfig
config BR2_PACKAGE_CRC_TEST_MOD
	bool "crc-test-mod"
  depends on BR2_LINUX_KERNEL
  help
    Kernel driver for NJD CRC PCI Device

    https://github.com/nj-designs

comment "crc-test-mod needs a linux kernel"
  depends on !BR2_LINUX_KERNEL
```

## br-external/package/crc_xcel_lib/Config.in
```kconfig
config BR2_PACKAGE_CRC_XCEL_LIB
	bool "crc-xcel-lib"
  depends on BR2_PACKAGE_CRC_XCEL_MOD
  help
    library for crc_xcel driver

    https://github.com/nj-designs

comment "Needs kernel module"
  depends on !BR2_PACKAGE_CRC_XCEL_MOD
```

## br-external/package/crc_xcel_mod/Config.in
```kconfig
config BR2_PACKAGE_CRC_XCEL_MOD
	bool "crc-xcel-mod"
  depends on BR2_LINUX_KERNEL
  help
    Kernel driver for CRC accelerator PCI card

    https://github.com/nj-designs

comment "crc-xcel-mod needs a linux kernel"
  depends on !BR2_LINUX_KERNEL
```

## br-external/package/lua_mod/Config.in
```kconfig
config BR2_PACKAGE_LUA_MOD
	bool "lua-mod"
  depends on BR2_LINUX_KERNEL
  help
    Lua module

    https://github.com/nj-designs

comment "lua-mod needs a linux kernel"
  depends on !BR2_LINUX_KERNEL
```
